## boards/shields/o_keyboard/Kconfig.defconfig
```kconfig
if SHIELD_O_KEYBOARD_LEFT

# Name must be less than 16 characters long!
config ZMK_KEYBOARD_NAME
    default "O-Keyboard"

config ZMK_SPLIT_ROLE_CENTRAL
    default y

endif

if SHIELD_O_KEYBOARD_LEFT || SHIELD_O_KEYBOARD_RIGHT

config ZMK_SPLIT
    default y

endif
```

## boards/shields/o_keyboard/Kconfig.shield
```kconfig
# No whitespace after the comma or in your part name!
config SHIELD_O_KEYBOARD_LEFT
    def_bool $(shields_list_contains,o_keyboard_left)

# No whitespace after the comma or in your part name!
config SHIELD_O_KEYBOARD_RIGHT
    def_bool $(shields_list_contains,o_keyboard_right)
```
